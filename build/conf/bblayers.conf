## build/conf/bblayers.conf
```bitbake
# LAYER_CONF_VERSION is increased each time build/conf/bblayers.conf
# changes incompatibly
LCONF_VERSION = "4"

BBFILES ?= ""
BBLAYERS ?= " \
  /media/OE/beagle/poky/meta \
  /media/OE/beagle/poky/meta-yocto \
  /media/OE/beagle/poky/meta-openembedded/meta-oe \
  /media/OE/beagle/poky/meta-angstrom \
  "
```
